/ {
    chosen {
        zmk,keyboard-matrix = &kbd_matrix;
    };

    kbd_matrix: kbd_matrix {
        compatible = "zmk,keyboard-matrix-gpio";
        label = "KBD_MATRIX";

        row-gpios = <
            &gpio0 6  GPIO_ACTIVE_HIGH
            &gpio0 8  GPIO_ACTIVE_HIGH
            &gpio0 17 GPIO_ACTIVE_HIGH
            &gpio0 20 GPIO_ACTIVE_HIGH
            &gpio0 22 GPIO_ACTIVE_HIGH
            &gpio0 24 GPIO_ACTIVE_HIGH
            &gpio1 0  GPIO_ACTIVE_HIGH
            &gpio1 2  GPIO_ACTIVE_HIGH
        >;

        col-gpios = <
            &gpio0 9  GPIO_ACTIVE_HIGH
            &gpio0 10 GPIO_ACTIVE_HIGH
            &gpio0 11 GPIO_ACTIVE_HIGH
            &gpio0 12 GPIO_ACTIVE_HIGH
            &gpio0 13 GPIO_ACTIVE_HIGH
            &gpio0 14 GPIO_ACTIVE_HIGH
            &gpio0 15 GPIO_ACTIVE_HIGH
            &gpio0 16 GPIO_ACTIVE_HIGH
            &gpio0 18 GPIO_ACTIVE_HIGH
            &gpio0 19 GPIO_ACTIVE_HIGH
            &gpio0 21 GPIO_ACTIVE_HIGH
            &gpio0 23 GPIO_ACTIVE_HIGH
            &gpio0 25 GPIO_ACTIVE_HIGH
            &gpio0 26 GPIO_ACTIVE_HIGH
            &gpio1 1  GPIO_ACTIVE_HIGH
            &gpio1 3  GPIO_ACTIVE_HIGH
            &gpio1 4  GPIO_ACTIVE_HIGH
            &gpio1 6  GPIO_ACTIVE_HIGH
        >;

        diode-direction = "col2row";
    };
};
